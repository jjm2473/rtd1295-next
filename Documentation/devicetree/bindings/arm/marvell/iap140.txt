## Documentation/devicetree/bindings/mmc/sdhci-fujitsu.txt
```
* Fujitsu SDHCI controller

This file documents differences between the core properties in mmc.txt
and the properties used by the sdhci_f_sdh30 driver.

Required properties:
- compatible: "fujitsu,f_sdh30"

Optional properties:
- revs-no-1v8: bitmap of EVB board revisions lacking 1.8V capability
  b0 = rev 0, b1 = rev 1, etc
- gpios: Specify gpios for controlling signal level
- clocks: Specify clocks used by SDHCI controller
- clock-names: Specify the clock-names to be used

Example:

	sdhci1: sdio@36600000 {
		compatible = "fujitsu,f_sdh30";
		reg = <0 0x36600000 0x1000>;
		interrupts = <0 172 0x4>,
			     <0 173 0x4>;
		gpios = <&gpio0 7 0>;
		revs-no-1v8 = <1>;
		clocks = <&clk_hdmi_2_0>, <&clk_hdmi_3_0>;
		clock-names = "sd_sd4clk", "sd_bclk";
	};
```

## Documentation/devicetree/bindings/nvmem/realtek,rtd1195-efuse.yaml
```yaml
# SPDX-License-Identifier: (GPL-2.0-or-later OR BSD-2-Clause)
%YAML 1.2
---
$id: "http://devicetree.org/schemas/nvmem/realtek,rtd1195-efuse.yaml#"
$schema: "http://devicetree.org/meta-schemas/core.yaml#"

title: Realtek Digital Home Center eFuse

maintainers:
  - Andreas Färber <afaerber@suse.de>

description: |
  The Realtek DHC SoCs have an eFuse block with non-volatile OTP memory.

allOf:
  - $ref: "nvmem.yaml#"

properties:
  compatible:
    const: realtek,rtd1195-efuse

  reg:
    maxItems: 1

  "#address-cells":
    const: 1

  "#size-cells":
    const: 1

required:
  - compatible
  - reg

examples:
  - |
    efuse@18017000 {
        compatible = "realtek,rtd1195-efuse";
        reg = <0x18017000 0x400>;
    };
  - |
    efuse@98017000 {
        compatible = "realtek,rtd1195-efuse";
        reg = <0x98017000 0x400>;
        #address-cells = <1>;
        #size-cells = <1>;

        efuse_package_id: package-id@1d8 {
            reg = <0x1d8 0x1>;
            bits = <0 2>;
        };
    };
...
```

## Documentation/devicetree/bindings/pci/fujitsu-pcie.txt
```
* Fujitsu F_PCIE2_DME PCIe interface

Required properties:
- compatible: should contain "fujitsu,xxx-yyy" to identify the
       core, plus an identifier for the specific instance, such
       as "fujitsu,sysoc-f_pcie_dmx".
- #address-cells: set to <2>
- #size-cells: set to  <1>
- reg: base addresses and lengths of the system controller.


Sub-nodes:
- compatible: should contain "fujitsu,xxx-yyy" to identify the
       core, plus an identifier for the specific instance, such
       as "fujitsu,f_pcie_dme".
- PME_INT: This indicates PME interrupt number offset in
       interrupts field.
- #address-cells: set to <2>
- #size-cells: set to  <1>
- id: it indicate pci channel number, 0 say channel-0, 1 say channel-1.
- reg:
      offset 0 :base addresses and lengths of the pcie controller.
      offset 1 :base addresses and lengths of the bifurcation controller.
- #interrupt-cells: set to <1>
- interrupt-map-mask and interrupt-map: standard PCI properties
	to define the mapping of the PCIe interface to interrupt
	numbers.
- clocks: from common clock binding: handle to pci clock.
- clock-names: from common clock binding:
       should be "bus_pcie_aclk", "pcie0_aclk", "pcie1_aclk".
- clock_num: Clock total number.
- #address-cells: set to <3>
- #size-cells: set to <2>
- ranges: ranges for the PCI memory and I/O regions

Example:
	pcie1_x2len:pcie1_x2len@0x33E00600 {
		status = "disabled";
		compatible = "fujitsu,sysoc-f_pcie_dmx";
		#address-cells = <2>;
		#size-cells = <1>;
		ranges;
		reg = <0 0x33E00600 0x64>, <0 0x33E00168 0x4>;

		pcie1_x2len_core: pcie1_x2len_core@320C0000 {
			compatible = "fujitsu,mb86s7x-pcie_dme-integration";
			sysoc = <0 0x33E00100 0x100>;
			id = <2>;
			ven_dev_id = <0x10cf 0x2043>;
			reg = <0 0x320C0000 0x20000>, <0 0x320E0000 0x1000>;
			interrupts = <0 454 4>;
			interrupt-map-mask = <0 0 0 15>;
			interrupt-map = <0 0 0 1 &gic 0 450 4>,
				<0 0 0 2 &gic 0 451 4>,
				<0 0 0 3 &gic 0 452 4>,
				<0 0 0 4 &gic 0 453 4>;
			pme_int_off = <0>;
			clocks = <&clk_alw_0_0>,<&clk_alw_0_1>,<&clk_alw_0_2>,
				<&clk_alw_2_0>,<&clk_alw_2_1>,<&clk_alw_2_2>;
			clock-names = "bus_pcie_aclk","pcie0_aclk","pcie1_aclk",
				"pcie_pclk","pcie0_hclk","pcie1_hclk";
			clock_num = <6>;
			#address-cells = <3>;
			#size-cells = <2>;
			ranges = <0x01000000 0x0 0x00000000 0x0 0x5C000000 0 0x08000000
					0x02000000 0x0 0x08000000 0x0 0x78000000 0 0x02000000
					0x02000000 0x0 0x0A000000 0x0 0x7A000000 0 0x02000000
					0x02000000 0x0 0x0C000000 0x0 0x7C000000 0 0x02000000
					0x02000000 0x0 0x0E000000 0x0 0x7E000000 0 0x02000000
					0x03000000 0x0 0x80000000 0x10 0x80000000 0 0x40000000
					0x00000000 0x0 0xC0000000 0x0 0x32100000 0 0x00010000>;
		};
	};

	pcie1_x4len:pcie1_x4len@0x33E00100 {
		compatible = "fujitsu,sysoc-f_pcie_dmx";
		#address-cells = <2>;
		#size-cells = <1>;
		ranges;
		reg = <0 0x33E00100 0x64>;

		pcie1_x4len_core: pcie1_x4len_core@32080000 {
			compatible = "fujitsu,mb86s7x-pcie_dme-integration";
			sysoc = <0 0x33E00100 0x100>;
			id = <1>;
			ven_dev_id = <0x10cf 0x2044>;
			reg = <0 32080000 0x20000>, <0 0x320A0000 0x1000>;
			interrupts = <0 264 4>;
			#interrupt-cells = <1>;
			interrupt-map-mask = <0 0 0 15>;
			interrupt-map = <0 0 0 1 &gic 0 260 4>,
				<0 0 0 2 &gic 0 261 4>,
				<0 0 0 3 &gic 0 262 4>,
				<0 0 0 4 &gic 0 263 4>;
			pme_int_off = <0>;
			clocks = <&clk_alw_0_0>,<&clk_alw_0_1>,<&clk_alw_0_2>,
				<&clk_alw_2_0>,<&clk_alw_2_1>,<&clk_alw_2_2>;
			clock-names = "bus_pcie_aclk","pcie0_aclk","pcie1_aclk",
				"pcie_pclk","pcie0_hclk","pcie1_hclk";
			clock_num = <6>;
			#address-cells = <3>;
			#size-cells = <2>;
			ranges = <0x01000000 0x0 0x00000000 0x0 0x58000000 0 0x08000000
					0x02000000 0x0 0x00000000 0x0 0x70000000 0 0x02000000
					0x02000000 0x0 0x02000000 0x0 0x72000000 0 0x02000000
					0x02000000 0x0 0x04000000 0x0 0x74000000 0 0x02000000
					0x02000000 0x0 0x06000000 0x0 0x76000000 0 0x02000000
					0x03000000 0x0 0x40000000 0x6 0x40000000 0 0x40000000
					0x00000000 0x0 0xC0000000 0x0 0x320F0000 0 0x00010000>;
		};
	};

	pcie0:pcie0@0x33E00000{
		compatible = "fujitsu,sysoc-f_pcie_dmx";
		#address-cells = <2>;
		#size-cells = <1>;
		ranges;
		reg = <0 0x33E00000 0x64>;

		pcie0_core: pcie0_core@32000000 {
			compatible = "fujitsu,mb86s7x-pcie_dme-integration";
			sysoc = <0 0x33E00000 0x100>;
			id = <0>;
			reg = <0 0x32000000 0x20000>, <0 0x320a0000 0x1000>;
			interrupts = <0 244 4>;
			#interrupt-cells = <1>;
			interrupt-map-mask = <0 0 0 15>;
			interrupt-map = <0 0 0 1 &gic 0 240 4>,
				<0 0 0 2 &gic 0 241 4>,
				<0 0 0 3 &gic 0 242 4>,
				<0 0 0 4 &gic 0 243 4>;
			pme_int_off = <0>;
			clocks = <&clk_alw_0_0>,<&clk_alw_0_1>,<&clk_alw_0_2>,
				<&clk_alw_2_0>,<&clk_alw_2_1>,<&clk_alw_2_2>;
			clock-names = "bus_pcie_aclk","pcie0_aclk","pcie1_aclk",
				"pcie_pclk","pcie0_hclk","pcie1_hclk";
			clock_num = <6>;
			#address-cells = <3>;
			#size-cells = <2>;
			ranges = <0x01000000 0x0 0x00000000 0x0 0x50000000 0 0x08000000
					0x02000000 0x0 0x00000000 0x0 0x60000000 0 0x04000000
					0x02000000 0x0 0x02000000 0x0 0x64000000 0 0x04000000
					0x02000000 0x0 0x08000000 0x0 0x68000000 0 0x04000000
					0x02000000 0x0 0x0C000000 0x0 0x6C000000 0 0x04000000
					0x03000000 0x0 0x40000000 0x4 0x40000000 0 0x40000000
					0x03000000 0x0 0x80000000 0x4 0x80000000 0 0x40000000
					0x00000000 0x0 0xC0000000 0x0 0x32060000 0 0x00010000>;
		};
	};
```

## Documentation/devicetree/bindings/pinctrl/realtek,rtd1195-pinctrl.yaml
```yaml
# SPDX-License-Identifier: (GPL-2.0-only OR BSD-2-Clause)
%YAML 1.2
---
$id: http://devicetree.org/schemas/pinctrl/realtek,rtd1195-pinctrl.yaml#
$schema: http://devicetree.org/meta-schemas/core.yaml#

title: Realtek DHC RTD1195 pin control

maintainers:
  - Andreas Farber <afaerber@suse.de>

properties:
  compatible:
    enum:
      - realtek,rtd1195-iso-pinctrl
      - realtek,rtd1195-crt-pinctrl
  reg:
    maxItems: 1

#PIN CONFIGURATION NODES
patternProperties:
  '(-pin|-pins)$':
    type: object
    description:
      Pinctrl node's client devices use subnodes for desired pin configuration.
      Client device subnodes use below standard properties.
    allOf:
      - $ref: "/schemas/pinctrl/pincfg-node.yaml"

    properties:
      pins:
        items:
          enum: [ iso_gpio_0, iso_gpio_1, usb0, usb1, vfd_cs_n,
          vfd_clk, vfd_d, ir_rx, ir_tx, ur0_rx, ur0_tx,
          ur1_rx, ur1_tx, ur1_cts_n, ur1_rts_n, i2c_scl_0,
          i2c_sda_0, etn_led_link, etn_led_rxtx,
          i2c_scl_6, i2c_sda_6, ai_loc, ejtag_avcpu_loc,
          ur1_loc, pwm_01_open_drain, pwm_23_open_drain,
          gpio_0, gpio_1, gpio_2, gpio_3, gpio_4, gpio_5,
          gpio_6, gpio_7, gpio_8, nf_dd_0, nf_dd_1,
          nf_dd_2, nf_dd_3, nf_dd_4, nf_dd_5, nf_dd_6,
          nf_dd_7, nf_rdy, nf_rd_n, nf_wr_n, nf_ale,
          nf_cle, nf_ce_n_0, nf_ce_n_1, mmc_data_0,
          mmc_data_1, mmc_data_2, mmc_data_3, mmc_clk,
          mmc_cmd, mmc_wp, mmc_cd, sdio_clk, sdio_data_0,
          sdio_data_1, sdio_data_2, sdio_data_3, sdio_cmd,
          i2c_scl_5, i2c_sda_5, tp1_data, tp1_clk,
          tp1_valid, tp1_sync, tp0_data, tp0_clk,
          tp0_valid, tp0_sync, usb_id, hdmi_hpd, spdif,
          i2c_scl_1, i2c_sda_1, i2c_scl_4, i2c_sda_4,
          sensor_cko_0, sensor_cko_1, sensor_rst,
          sensor_stb_0, sensor_stb_1, ejtag_scpu_loc,
          hif_loc, ao_loc ]
        minItems: 1

      groups:
        items:
          enum: [ iso_gpio_0, iso_gpio_1, usb0, usb1, vfd_cs_n,
          vfd_clk, vfd_d, ir_rx, ir_tx, ur0_rx, ur0_tx,
          ur1_rx, ur1_tx, ur1_cts_n, ur1_rts_n, i2c_scl_0,
          i2c_sda_0, etn_led_link, etn_led_rxtx,
          i2c_scl_6, i2c_sda_6, ai_loc, ejtag_avcpu_loc,
          ur1_loc, pwm_01_open_drain, pwm_23_open_drain,
          gpio_0, gpio_1, gpio_2, gpio_3, gpio_4, gpio_5,
          gpio_6, gpio_7, gpio_8, nf_dd_0, nf_dd_1,
          nf_dd_2, nf_dd_3, nf_dd_4, nf_dd_5, nf_dd_6,
          nf_dd_7, nf_rdy, nf_rd_n, nf_wr_n, nf_ale,
          nf_cle, nf_ce_n_0, nf_ce_n_1, mmc_data_0,
          mmc_data_1, mmc_data_2, mmc_data_3, mmc_clk,
          mmc_cmd, mmc_wp, mmc_cd, sdio_clk, sdio_data_0,
          sdio_data_1, sdio_data_2, sdio_data_3, sdio_cmd,
          i2c_scl_5, i2c_sda_5, tp1_data, tp1_clk,
          tp1_valid, tp1_sync, tp0_data, tp0_clk,
          tp0_valid, tp0_sync, usb_id, hdmi_hpd, spdif,
          i2c_scl_1, i2c_sda_1, i2c_scl_4, i2c_sda_4,
          sensor_cko_0, sensor_cko_1, sensor_rst,
          sensor_stb_0, sensor_stb_1, ejtag_scpu_loc,
          hif_loc, ao_loc ]
        minItems: 1

      function:
        enum: [ gpio, ai_ur1, ai_vfd, avcpu_ejtag_iso,
        avcpu_ejtag_misc_loc, etn_led, i2c0, i2c2,
        i2c3, i2c6, ir_rx, ir_tx, pwm, standby_dbg,
        uart0, uart1, ur1_misc, vfd, pwm_01_normal,
        pwm_23_normal, pwm_01_open_drain, pwm_23_open_drain,
        ao_tp0, ao_gpio, avcpu_ejtag_misc, cpu_loop, emmc,
        gspi, hif_misc, hif_nf, i2c1, i2c2, i2c3,
        i2c4, i2c5, mmc, nand, scpu_ejtag_gpio,
        scpu_ejtag_cr, sdio, sensor, spdif, tp0, tp1,
        uart1, usb ]

      drive-strength:
        enum: [2, 4, 8]

      bias-pull-down: true

      bias-pull-up: true

      bias-disable: true

      input-schmitt-disable: true

      input-schmitt-enable: true

    oneOf:
      - required:
        - pins
      - required:
        - groups

    additionalProperties: false

required:
  - compatible
  - reg

additionalProperties: false

examples:
  - |
    iso_pinctrl: pinctrl@300 {
        compatible = "realtek,rtd1195-iso-pinctrl";
        reg = <0x300 0x14>;

        i2c0_pins: i2c0-pins {
            function = "i2c0";
            groups = "i2c_scl_0", "i2c_sda_0";
            drive-strength = <4>;
            bias-disable;
        };
    };
```
