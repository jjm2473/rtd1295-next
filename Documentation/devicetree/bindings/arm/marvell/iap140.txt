## Documentation/devicetree/bindings/arm/marvell/iap140.txt
```
Marvell IAP140 Device Tree Bindings
-----------------------------------

Boards using a SoC of the Marvell IAP140 family must carry the following
root node property:

 - compatible :  must contain "marvell,iap140"

Example:

    compatible = "marvell,andromeda-box-edge", "marvell,iap140";
```

## Documentation/devicetree/bindings/arm/realtek.txt
```
Realtek platforms device tree bindings
--------------------------------------


RTD1293 SoC
===========

Required root node properties:

 - compatible :  must contain "realtek,rtd1293"


Root node property compatible must contain, depending on board:

 - Synology DiskStation DS418j: "synology,ds418j"

Example:

    compatible = "synology,ds418j", "realtek,rtd1293";


RTD1295 SoC
===========

Required root node properties:

 - compatible :  must contain "realtek,rtd1295"


Root node property compatible must contain, depending on board:

 - MeLE V9: "mele,v9"
 - ProBox2 AVA: "probox2,ava"
 - Zidoo X9S: "zidoo,x9s"


Example:

    compatible = "zidoo,x9s", "realtek,rtd1295";
```

## Documentation/devicetree/bindings/arm/realtek.yaml
```yaml
# SPDX-License-Identifier: GPL-2.0-or-later OR BSD-2-Clause
%YAML 1.2
---
$id: http://devicetree.org/schemas/arm/realtek.yaml#
$schema: http://devicetree.org/meta-schemas/core.yaml#

title: Realtek platforms device tree bindings

maintainers:
  - Andreas Färber <afaerber@suse.de>

properties:
  $nodename:
    const: '/'
  compatible:
    oneOf:
      - description: RTD1195 SoC based boards
        items:
          - enum:
              - mele,x1000 # MeLE X1000
              - realtek,horseradish # Realtek Horseradish EVB
          - const: realtek,rtd1195

      - description: RTD1293 SoC based boards
        items:
          - enum:
              - synology,ds418j # Synology DiskStation DS418j
          - const: realtek,rtd1293

      - description: RTD1295 SoC based boards
        items:
          - enum:
              - mele,v9 # MeLE V9
              - probox2,ava # ProBox2 AVA
              - xnano,x5 # Xnano X5
              - zidoo,x9s # Zidoo X9S
          - const: realtek,rtd1295

      - description: RTD1296 SoC based boards
        items:
          - enum:
              - bananapi,bpi-w2 # Banana Pi BPI-W2
              - realtek,saola # Realtek Saola EVB
              - synology,ds418 # Synology DiskStation DS418
          - const: realtek,rtd1296

      - description: RTD1319 SoC based boards
        items:
          - enum:
              - realtek,pym-particles # Realtek Pym Particles EVB
          - const: realtek,rtd1319

      - description: RTD1395 SoC based boards
        items:
          - enum:
              - bananapi,bpi-m4 # Banana Pi BPI-M4
              - realtek,lion-skin # Realtek Lion Skin EVB
          - const: realtek,rtd1395

      - description: RTD1619 SoC based boards
        items:
          - enum:
              - realtek,mjolnir # Realtek Mjolnir EVB
          - const: realtek,rtd1619
...
```

## Documentation/devicetree/bindings/arm/socionext.txt
```
Socionext platforms device tree bindings
----------------------------------------


MB86S7x SoC
===========

Required root node properties:

 - compatible :  must contain "fujitsu,mb86s71" for MB86S71


Boards:

Root node property compatible must contain, depending on board:

 - Fujitsu F-Cue: "fujitsu,f-cue"
```

## Documentation/devicetree/bindings/arm/sunplus.yaml
```yaml
# SPDX-License-Identifier: GPL-2.0-or-later OR BSD-2-Clause
%YAML 1.2
---
$id: http://devicetree.org/schemas/arm/sunplus.yaml#
$schema: http://devicetree.org/meta-schemas/core.yaml#

title: Sunplus platforms device tree bindings

maintainers:
  - Andreas Färber <afaerber@suse.de>

properties:
  $nodename:
    const: '/'
  compatible:
    oneOf:
      # SP7021 SoC based boards
      - items:
          - enum:
              - bananapi,bpi-f2s # Banana Pi BPI-F2S
          - const: sunplus,sp7021
...
```

## Documentation/devicetree/bindings/clock/realtek,rtd129x.txt
```
Realtek RTD129x clock controllers
=================================

Requires properties:
- compatible   :  Should be one of the following:
                  - "realtek,rtd1295-clk"
                  - "realtek,rtd1295-iso-clk"
- reg          :  Specifies physical base address and size
- clocks       :  Specifies the oscillator node
- #clock-cells :  Shall be 1


Example:

	clock-controller@98000000 {
		compatible = "realtek,rtd1295-clk";
		reg = <0x98000000 0x1000>;
		clocks = <&osc27M>;
		#clock-cells = <1>;
	};
```

## Documentation/devicetree/bindings/gpu/fujitsu-malit6xx.txt
```
* Fujitsu Mali T6xx Graphic Processing Unit

Required properties:
  - compatible : value should be "fujitsu,malit6xx"
  - reg : Address and length of the register memory map.
  - interrupts : interrupt numbers to the CPU.
  - clocks : Refer
    Documentation/devicetree/bindings/clock/clock-bindings.txt.
  - clock-names : Refer
    Documentation/devicetree/bindings/clock/clock-bindings.txt.
  - fujistu-powerdomain : this property defined with a phandle to
    respective power domain.
  - cci-control-port : a phandle containing the CCI control interface node
            the master is connected to.

Example:
	mali0: mali@2d000000 {
		compatible = "fujitsu,malit6xx";
		reg = <0 0x2d000000 0x10000>;
		interrupts = <0 33 4>, /* Mali JOB */
			     <0 34 4>, /* Mali MMU */
			     <0 32 4>; /* Mali GPU */
		clocks = <&clk_main_7_0>, <&clk_main_2_0>, <&clk_main_0_0>, <&clk_main_4_0>;
		clock-names = "g3d", "aclk_g3d", "mout_gpll", "fout_gpll";
		#stream-id-cells = <0>;
		fujitsu,power-domain = <&pd_mali>;
		cci-control-port = <&cci_control2>;
	};
```

## Documentation/devicetree/bindings/hwlock/realtek,rtd1195-sb2-sem.yaml
```yaml
# SPDX-License-Identifier: GPL-2.0-or-later OR BSD-2-Clause
%YAML 1.2
---
$id: http://devicetree.org/schemas/hwlock/realtek,rtd1195-sb2-sem.yaml#
$schema: http://devicetree.org/meta-schemas/core.yaml#

title: Realtek RTD1195 SB2 hardware semaphore device tree binding

maintainers:
  - Andreas Färber <afaerber@suse.de>

properties:
  compatible:
    const: realtek,rtd1195-sb2-sem

  reg:
    maxItems: 1

  "#hwlock-cells":
    enum: [ 0, 1 ]

required:
  - compatible
  - reg
  - "#hwlock-cells"

additionalProperties: false

examples:
  - |
    hwspinlock@9801a000 {
      compatible = "realtek,rtd1195-sb2-sem";
      reg = <0x9801a000 0x4>;
      #hwlock-cells = <0>;
    };
  - |
    hwspinlock@9801a620 {
      compatible = "realtek,rtd1195-sb2-sem";
      reg = <0x9801a620 0x20>;
      #hwlock-cells = <1>;
    };
...
```

## Documentation/devicetree/bindings/interrupt-controller/realtek,rtd1195-mux.yaml
```yaml
# SPDX-License-Identifier: (GPL-2.0-or-later OR BSD-2-Clause)
%YAML 1.2
---
$id: http://devicetree.org/schemas/interrupt-controller/realtek,rtd1195-mux.yaml#
$schema: http://devicetree.org/meta-schemas/core.yaml#

title: Realtek RTD1195/1295 IRQ Mux Controller

maintainers:
  - Andreas Färber <afaerber@suse.de>

allOf:
  - $ref: /schemas/interrupt-controller.yaml#

properties:
  compatible:
    enum:
      - realtek,rtd1195-misc-irq-mux
      - realtek,rtd1195-iso-irq-mux
      - realtek,rtd1295-misc-irq-mux
      - realtek,rtd1295-iso-irq-mux

  reg:
    maxItems: 1

  interrupts:
    description: Specifies the interrupt line which is mux'ed.
    maxItems: 1

  interrupt-controller: true

  "#interrupt-cells":
    const: 1

required:
  - compatible
  - reg
  - interrupts
  - interrupt-controller
  - "#interrupt-cells"

examples:
  - |
    #include <dt-bindings/interrupt-controller/arm-gic.h>

    interrupt-controller@98007000 {
        compatible = "realtek,rtd1295-iso-irq-mux";
        reg = <0x98007000 0x100>;
        interrupts = <GIC_SPI 41 IRQ_TYPE_LEVEL_HIGH>;
        interrupt-controller;
        #interrupt-cells = <1>;
    };
...
```

## Documentation/devicetree/bindings/interrupt-controller/realtek,rtd119x-mux.txt
```
Realtek RTD119x/129x IRQ Mux Controller
=======================================

Required properties:

- compatible           :  Should be one of the following:
                          - "realtek,rtd1195-misc-irq-mux"
                          - "realtek,rtd1195-iso-irq-mux"
                          - "realtek,rtd1295-misc-irq-mux"
                          - "realtek,rtd1295-iso-irq-mux"
- reg                  :  Specifies base physical address and size of the registers.
- interrupts           :  Specifies the interrupt line which is mux'ed.
- interrupt-controller :  Presence indicates the node as interrupt controller.
- #interrupt-cells     :  Shall be 1. See common bindings in interrupt.txt.


Example:

	interrupt-controller@98007000 {
		compatible = "realtek,rtd1295-iso-irq-mux";
		reg = <0x98007000 0x100>;
		interrupts = <GIC_SPI 41 IRQ_TYPE_LEVEL_HIGH>;
		interrupt-controller;
		#interrupt-cells = <1>;
	};
```

## Documentation/devicetree/bindings/interrupt-controller/sunplus,pentagram-intc.yaml
```yaml
# SPDX-License-Identifier: GPL-2.0-or-later OR BSD-2-Clause
%YAML 1.2
---
$id: http://devicetree.org/schemas/interrupt-controller/sunplus,pentagram-intc.yaml#
$schema: http://devicetree.org/meta-schemas/core.yaml#

title: Sunplus Pentagram SoC Interrupt Controller

maintainers:
  - Andreas Färber <afaerber@suse.de>

allOf:
  - $ref: /schemas/interrupt-controller.yaml#

properties:
  compatible:
    const: sunplus,sp7021-intc

  reg:
    maxItems: 2

  interrupts:
    maxItems: 2

  interrupt-controller: true

  "#interrupt-cells":
    const: 2

required:
  - compatible
  - reg
  - interrupt-controller

unevaluatedProperties: false

examples:
  - |
    #include <dt-bindings/interrupt-controller/arm-gic.h>

    interrupt-controller@9c000780 {
        compatible = "sunplus,sp7021-intc";
        reg = <0x9c000780 0x80>,
              <0x9c000a80 0x80>;
        interrupts = <GIC_SPI 5 IRQ_TYPE_LEVEL_HIGH>,
                     <GIC_SPI 6 IRQ_TYPE_LEVEL_HIGH>;
        interrupt-controller;
        #interrupt-cells = <2>;
    };
...
```

## Documentation/devicetree/bindings/leds/titanmec,tm1628.yaml
```yaml
# SPDX-License-Identifier: (GPL-2.0-or-later OR BSD-2-Clause)
%YAML 1.2
---
$id: http://devicetree.org/schemas/leds/titanmec,tm1628.yaml#
$schema: http://devicetree.org/meta-schemas/core.yaml#

title: Titan Micro Electronics TM1628 LED controller

maintainers:
  - Andreas Färber <afaerber@suse.de>

properties:
  compatible:
    enum:
    - fdhisi,fd628
    - holtek,ht16515
    - szfdwdz,aip1618
    - titanmec,tm1628

  reg:
    maxItems: 1

  "#grids":
    description: |
      Number of GRID output lines to use.
      This limits the number of available SEG output lines.
    minimum: 4
    maximum: 7

  "#address-cells":
    const: 2

  "#size-cells":
    const: 0

required:
  - compatible
  - reg

patternProperties:
  "^.*@[1-7],([1-9]|1[02-4])$":
    type: object
    description: |
      Properties for a single LED.

    properties:
      reg:
        description: |
          1-based grid number, followed by 1-based segment number.
        maxItems: 1

      linux,default-trigger: true

    required:
      - reg

  "^display@([1-7],0|0,([1-9]|1[02-4]))$":
    type: object
    description: |
      Properties for a sequence of 7-segment digits composed of multiple LEDs.

    properties:
      reg:
        description: |
          One or more tuples of grid number and segment number in visual order.
          A segment of zero indicates that the corresponding grid output lines
          represent the individual segments; a grid of zero indicates that the
          corresponding segment output lines represent the individual segments.
        minItems: 1
        maxItems: 7

    required:
      - reg

examples:
  - |
    #include <dt-bindings/leds/common.h>

    spi {
        #address-cells = <1>;
        #size-cells = <0>;

        led-controller@0 {
            compatible = "titanmec,tm1628";
            reg = <0>;
            spi-3-wire;
            spi-lsb-first;
            spi-max-frequency = <500000>;
            #grids = <7>;
            #address-cells = <2>;
            #size-cells = <0>;

            display@0,8 {
                reg = <0 8>, <0 7>, <0 6>, <0 5>;
            };

            colon@5,4 {
                reg = <5 4>;
                color = <LED_COLOR_ID_WHITE>;
                function = LED_FUNCTION_INDICATOR;
                linux,default-trigger = "heartbeat";
            };
        };
    };

  - |
    #include <dt-bindings/leds/common.h>

    spi {
        #address-cells = <1>;
        #size-cells = <0>;

        led-controller@0 {
            compatible = "titanmec,tm1628";
            reg = <0>;
            spi-3-wire;
            spi-lsb-first;
            spi-max-frequency = <500000>;
            #grids = <6>;
            #address-cells = <2>;
            #size-cells = <0>;

            display@1,0 {
                reg = <1 0>, <2 0>, <3 0>, <4 0>;
            };

            colon@5,4 {
                reg = <5 4>;
                color = <LED_COLOR_ID_WHITE>;
                function = LED_FUNCTION_INDICATOR;
                linux,default-trigger = "heartbeat";
            };
        };
    };
...
```

## Documentation/devicetree/bindings/mipi/fujitsu_mipi_lli.txt
```
* Fujitsu MIPI-LLI interface

Required properties:
- compatible: should contain "fujitsu,xxx-yyy" to identify the
	core, plus an identifier for the specific instance, such
	as "fujitsu,mb86s70-mipilli".
- #address-cells: set to <2>
- #size-cells: set to  <1>
- llix: x indicate channel number, such as pcie0, pcie1.
	pciex include themselves base address, id.
	Below will introduce them.
- id: it indicate pci channel number, 0 say channel-0, 1 say channel-1.
- reg: base addresses and lengths of the pcie controller.
- interrupts: interrupt values for level interrupt,
	pulse interrupt, special interrupt.
- irq-name: it will show interrupt name in linux shell.
- clocks: from common clock binding: handle to pci clock.
- clock-names: from common clock binding:
	should be "aclk", "pclk".
- #stream-id-cells: For iommu stream id.

Example:
	mipilli {
		compatible = "fujitsu,mb86s70-mipilli";
		#address-cells = <2>;
		#size-cells = <1>;
		ranges;
		lli0: mipilli0@0x32400000{
			id = <0>;
			reg = <0 0x32400000 0x10000>;
			interrupts = <0 232 0x4>;
			irq-name = "lli-0";
			clocks = <&clk_alw_0_4>, <&clk_alw_2_4>, <&clk_alw_a_0>;
			clock-names = "aclk", "pclk", "tx_bit_clk";
			#stream-id-cells = <0>;
		};
		lli1: mipilli1@0x32410000{
			id = <1>;
			reg = <0 0x32410000 0x10000>;
			interrupts = <0 236 0x4>;
			irq-name = "lli-1";
			clocks = <&clk_alw_0_5>, <&clk_alw_2_5>, <&clk_alw_a_1>;
			clock-names = "aclk", "pclk", "tx_bit_clk";
			#stream-id-cells = <0>;
		};
	};
```

## Documentation/devicetree/bindings/misc/fujitsu-media-shell.txt
```
* Fujitsu Media IP units shell

Fujitsu Media IP units are present in Fujitsu MB86S7x SoCs,
including multi-standard codecs, called jpegtx and wave320.

Required properties:
- compatible : one of:
- "fujitsu,jpegtx"
- "fujitsu,wave320"
- reg: register base and length for the device.
- id : Identification number.
- interrupts : should contain the media ip units interrupt.
- clocks : Refer Documentation/devicetree/bindings/clock/clock-bindings.txt
- clock-names : Refer Documentation/devicetree/bindings/clock/clock-bindings.txt

Example:
	jpeg: jpeg {
		compatible = "fujitsu,jpegtx";
		reg = <0 0x36020000 0x10000>;
		id = <0>;
		interrupts = <0 190 0x4>;
		clocks = <&clk_main_5_5>, <&clk_main_8_1>;
		clock-names = "clk1", "clk2";
	};
```
