## Documentation/devicetree/bindings/pinctrl/realtek,rtd1295-pinctrl.yaml
```yaml
# SPDX-License-Identifier: (GPL-2.0-only OR BSD-2-Clause)
%YAML 1.2
---
$id: http://devicetree.org/schemas/pinctrl/realtek,rtd1295-pinctrl.yaml#
$schema: http://devicetree.org/meta-schemas/core.yaml#

title: Realtek DHC RTD1295 pin control

maintainers:
  - Andreas Farber <afaerber@suse.de>

properties:
  compatible:
    enum:
      - realtek,rtd1295-iso-pinctrl
      - realtek,rtd1295-sb2-pinctrl
      - realtek,rtd1295-disp-pinctrl
      - realtek,rtd1295-cr-pinctrl
  reg:
    maxItems: 1

#PIN CONFIGURATION NODES
patternProperties:
  '(-pin|-pins)$':
    type: object
    description:
      Pinctrl node's client devices use subnodes for desired pin configuration.
      Client device subnodes use below standard properties.
    allOf:
      - $ref: "/schemas/pinctrl/pincfg-node.yaml"

    properties:
      pins:
        items:
          enum: [ iso_gpio_0, iso_gpio_1, iso_gpio_2, iso_gpio_3, iso_gpio_4,
          iso_gpio_5, hdmi_hpd, iso_gpio_7, ir_rx, ir_tx, ur0_rx,
          ur0_tx, ur1_rx, ur1_tx, ur1_cts_n, ur1_rts_n, i2c_scl_0,
          i2c_sda_0, i2c_scl_1, i2c_sda_1, i2c_scl_6, iso_gpio_21,
          iso_gpio_22, iso_gpio_23, iso_gpio_24, iso_gpio_25,
          i2c_sda_6, etn_led_link, etn_led_rxtx, nat_led_0,
          nat_led_1, nat_led_2, nat_led_3, iso_gpio_33,
          iso_gpio_34, pwm_23_loc0, pwm_01_loc0, pwm_23_loc1,
          pwm_01_loc1, ejtag_avcpu_loc, ur2_loc, i2c0, i2c1,
          i2c6, uart0, uart1, uart2_0, uart2_1, gpio_0, gpio_1,
          gpio_2, gpio_3, gpio_4, gpio_5, gpio_6, gpio_7, gpio_8,
          gpio_9, tp1_sync, i2c_scl_4, i2c_sda_4, i2c_scl_5,
          i2c_sda_5, usb_id, sensor_cko_0, sensor_cko_1, sensor_rst,
          sensor_stb_0, sensor_stb_1, tp0_data, tp0_clk, tp0_valid,
          tp0_sync, tp1_data, tp1_clk, tp1_valid, rgmii0_txc,
          rgmii0_tx_ctl,rgmii0_txd_0, rgmii0_txd_1, rgmii0_txd_2,
          rgmii0_txd_3, rgmii0_rxc, rgmii0_rx_ctl, rgmii0_rxd_0,
          rgmii0_rxd_1, rgmii0_rxd_2, rgmii0_rxd_3, rgmii0_mdio,
          rgmii0_mdc, rgmii1_txc, rgmii1_tx_ctl, rgmii1_txd_0,
          rgmii1_txd_1, rgmii1_txd_2, rgmii1_txd_3, rgmii1_rxc,
          rgmii1_rx_ctl, rgmii1_rxd_0, rgmii1_rxd_1, rgmii1_rxd_2,
          rgmii1_rxd_3, hif_loc, ejtag_scpu_loc, sf_en, tp0_loc,
          tp1_loc, spdif, dmic_clk, dmic_data, ao_lrck, ao_bck,
          aock, ao_sd_0, ao_sd_1, ao_sd_2, ao_sd_3, nf_cle,
          nf_ale, nf_rd_n, nf_wr_n, nf_rdy, nf_dd_7, nf_dd_6,
          nf_dd_5, nf_dd_4, nf_dd_3, nf_dd_2, nf_dd_1, nf_dd_0,
          nf_dqs, nf_ce_n_0, nf_ce_n_1, emmc_dd_sb, mmc_cmd,
          mmc_clk, mmc_wp, mmc_cd, mmc_data_0, mmc_data_1,
          mmc_data_2, mmc_data_3, sdio_cmd, sdio_clk, sdio_data_0,
          sdio_data_1, sdio_data_2, sdio_data_3, pcie_clkreq_0,
          pcie_clkreq_1, prob_0, prob_1, prob_2, prob_3, sdio_loc ]
        minItems: 1

      groups:
        items:
          enum: [ iso_gpio_0, iso_gpio_1, iso_gpio_2, iso_gpio_3, iso_gpio_4,
          iso_gpio_5, hdmi_hpd, iso_gpio_7, ir_rx, ir_tx, ur0_rx,
          ur0_tx, ur1_rx, ur1_tx, ur1_cts_n, ur1_rts_n, i2c_scl_0,
          i2c_sda_0, i2c_scl_1, i2c_sda_1, i2c_scl_6, iso_gpio_21,
          iso_gpio_22, iso_gpio_23, iso_gpio_24, iso_gpio_25,
          i2c_sda_6, etn_led_link, etn_led_rxtx, nat_led_0,
          nat_led_1, nat_led_2, nat_led_3, iso_gpio_33,
          iso_gpio_34, pwm_23_loc0, pwm_01_loc0, pwm_23_loc1,
          pwm_01_loc1, ejtag_avcpu_loc, ur2_loc, i2c0, i2c1,
          i2c6, uart0, uart1, uart2_0, uart2_1, gpio_0, gpio_1,
          gpio_2, gpio_3, gpio_4, gpio_5, gpio_6, gpio_7, gpio_8,
          gpio_9, tp1_sync, i2c_scl_4, i2c_sda_4, i2c_scl_5,
          i2c_sda_5, usb_id, sensor_cko_0, sensor_cko_1, sensor_rst,
          sensor_stb_0, sensor_stb_1, tp0_data, tp0_clk, tp0_valid,
          tp0_sync, tp1_data, tp1_clk, tp1_valid, rgmii0_txc,
          rgmii0_tx_ctl,rgmii0_txd_0, rgmii0_txd_1, rgmii0_txd_2,
          rgmii0_txd_3, rgmii0_rxc, rgmii0_rx_ctl, rgmii0_rxd_0,
          rgmii0_rxd_1, rgmii0_rxd_2, rgmii0_rxd_3, rgmii0_mdio,
          rgmii0_mdc, rgmii1_txc, rgmii1_tx_ctl, rgmii1_txd_0,
          rgmii1_txd_1, rgmii1_txd_2, rgmii1_txd_3, rgmii1_rxc,
          rgmii1_rx_ctl, rgmii1_rxd_0, rgmii1_rxd_1, rgmii1_rxd_2,
          rgmii1_rxd_3, hif_loc, ejtag_scpu_loc, sf_en, tp0_loc,
          tp1_loc, spdif, dmic_clk, dmic_data, ao_lrck, ao_bck,
          aock, ao_sd_0, ao_sd_1, ao_sd_2, ao_sd_3, nf_cle,
          nf_ale, nf_rd_n, nf_wr_n, nf_rdy, nf_dd_7, nf_dd_6,
          nf_dd_5, nf_dd_4, nf_dd_3, nf_dd_2, nf_dd_1, nf_dd_0,
          nf_dqs, nf_ce_n_0, nf_ce_n_1, emmc_dd_sb, mmc_cmd,
          mmc_clk, mmc_wp, mmc_cd, mmc_data_0, mmc_data_1,
          mmc_data_2, mmc_data_3, sdio_cmd, sdio_clk, sdio_data_0,
          sdio_data_1, sdio_data_2, sdio_data_3, pcie_clkreq_0,
          pcie_clkreq_1, prob_0, prob_1, prob_2, prob_3, sdio_loc ]
        minItems: 1

      function:
        enum: [ gpio, acpu_ejtag_loc_iso, edp_hpd, etn_led, i2c0, i2c1, i2c6,
        ir_rx, ir_tx, nat_led, pwm_0, pwm_1, rtc, sc, standby_dbg,
        uart0, uart1, uart2_0, uart2_1, pwm_01_loc0_normal,
        pwm_23_loc0_normal, pwm_01_loc0_open_drain, pwm_23_loc0_open_drain,
        pwm_01_loc1_normal, pwm_23_loc1_normal, pwm_01_loc1_open_drain,
        pwm_23_loc1_open_drain, acpu_ejtag_loc_nf, ai, dc_fan_sensor,
        eth_gpy, gspi, i2c2, i2c3, i2c4, i2c5, nand, rgmii, scpu_ejtag_loc_gpio,
        sensor_cko_output, spi, test_loop_dis, tp0_loc_rgmii0_tx, tp0_loc_tp0,
        tp0_loc_tp1, tp1_loc_rgmii0_rx, tp1_loc_tp0, tp1_loc_tp1,
        usb_clock_output, hif_loc_misc, hif_loc_nf, scpu_ejtag_loc_cr, ao,
        dmic, spdif_out, avcpu_ej, emmc, hif, nand, p2s, pcie, pll_test,
        scpu_ejtag_loc_cr, sd_card, sdio_0, sdio_1 ]

      drive-strength:
        enum: [2, 4, 8]

      bias-pull-down: true

      bias-pull-up: true

      bias-disable: true

      input-schmitt-disable: true

      input-schmitt-enable: true

      rtk,pdrive:
        $ref: "/schemas/types.yaml#/definitions/uint32"
        minimum: 0
        maximum: 0xf
        description:
          For nand flash, emmc, sdio, sdmmc and emmc pins, there exists specific
          driving setup. We can adjust the postive drive or negative drive individually.
          "rtk,pdrive = <XXXX>" and "rtk,ndrive = <XXXX>" are used to describe the specific
          driving setup property. XXXX means the value of E5E4E3E2. They are the driving capability
          of the pins. "rtk,pdrive" use to adjust the positive drive; "rtk,ndrive" use to
          adjust the negative drive.
          E2, E3, E4 and E5 have different driving capability. There is also an EN which is always
          enabled and has basic driving capability. The driving capability of the pin is the sum
          of En, E2, E3, E4 and E5.
          The driving capability is corresponded to the driving current. It should be noted that the
          positive drive and the negative drive with the same driving capability value is corresponded
          to different driving current.
          The following is the pad driving mapping table.
          EN E2 E3 E4 E5      driving_capability    negative_drive(mA)  positive_drive(mA)
           1                       0.125                  1.3                  1.1
              1                    0.125                  1.3                  1.1
                 1                  0.25                  2.6                  2.2
                    1                0.5                  5.2                  4.4
                       1             0.5                  5.2                  4.4
      rtk,ndrive:
        $ref: "/schemas/types.yaml#/definitions/uint32"
        minimum: 0
        maximum: 0xf
        description:
          It used to setup negative drive of nand flash, emmc, sdio or emmc pins. It has
          been described in the description of the property "rtk,pdrive" above.

    oneOf:
      - required:
        - pins
      - required:
        - groups

    additionalProperties: false

required:
  - compatible
  - reg

additionalProperties: false

examples:
  - |
    iso_pinctrl: pinctrl@300 {
        compatible = "realtek,rtd1295-iso-pinctrl";
        reg = <0x300 0x24>;

        pinctrl-names = "default";
        pinctrl-0 = <&etn_led_pins>;

        etn_led_pins: etn-led-pins {
            function = "etn_led";
            groups = "etn_led_link", "etn_led_rxtx";
            bias-pull-up;
            drive-strength = <4>;
        };
    };
```

## Documentation/devicetree/bindings/reset/realtek,rtd129x-reset.txt
```
Realtek RTD129x Reset Controller
================================

Required properties:
- compatible   :  Should be "realtek,rtd1295-reset"
- reg          :  Should contain the register address and 4 as size.
- #reset-cells :  Should be 1

See reset.txt for common reset controller bindings.


Example:

	reset-controller@98000000 {
		compatible = "realtek,rtd1295-reset";
		reg = <0x98000000 0x4>;
		#reset-cells = <1>;
	};
```

## Documentation/devicetree/bindings/rtc/realtek,rtd1195.yaml
```yaml
# SPDX-License-Identifier: (GPL-2.0-or-later OR BSD-2-Clause)
%YAML 1.2
---
$id: http://devicetree.org/schemas/rtc/realtek,rtd1195.yaml#
$schema: http://devicetree.org/meta-schemas/core.yaml#

title: Realtek RTD129x Real-Time Clock

allOf:
  - $ref: "rtc.yaml#"

maintainers:
  - Andreas Färber <afaerber@suse.de>

properties:
  compatible:
    const: realtek,rtd1295-rtc

  reg:
    maxItems: 1

  clocks:
    maxItems: 1
    description: Specifies the clock gate

required:
  - compatible
  - reg
  - clocks

examples:
  - |
    rtc@9801b600 {
        compatible = "realtek,rtd1295-rtc";
        reg = <0x9801b600 0x100>;
        clocks = <&clkc 42>;
    };
...
```

## Documentation/devicetree/bindings/serial/rda-uart.txt
```
RDA Micro UART

Required properties:
- compatible :  "rda,8810pl-uart" for RDA8810PL
- reg        :  Offset and length of the register set for the device.


Example:

		uart3: serial@20a90000 {
			compatible = "rda,8810pl-uart";
			reg = <0x20a90000 0x1000>;
		};
```

## Documentation/devicetree/bindings/serial/sunplus,pentagram-uart.yaml
```yaml
# SPDX-License-Identifier: GPL-2.0-or-later OR BSD-2-Clause
%YAML 1.2
---
$id: http://devicetree.org/schemas/serial/sunplus,pentagram-uart.yaml#
$schema: http://devicetree.org/meta-schemas/core.yaml#

title: Sunplus Pentagram SoC UART Serial Interface

maintainers:
  - Andreas Färber <afaerber@suse.de>

properties:
  compatible:
    const: sunplus,sp7021-uart

  reg:
    maxItems: 1

  interrupts:
    maxItems: 1

  clocks:
    maxItems: 1
...
```

## Documentation/devicetree/bindings/soc/realtek/realtek,rtd1195-chip.yaml
```yaml
# SPDX-License-Identifier: (GPL-2.0-or-later OR BSD-2-Clause)
%YAML 1.2
---
$id: "http://devicetree.org/schemas/soc/realtek/realtek,rtd1195-chip.yaml#"
$schema: "http://devicetree.org/meta-schemas/core.yaml#"

title: Realtek Digital Home Center chip identification

maintainers:
  - Andreas Färber <afaerber@suse.de>

description: |
  The Realtek DHC SoCs have some registers to identify the chip and revision.
  To identify the exact model within a family, further registers are needed.

properties:
  compatible:
    const: realtek,rtd1195-chip

  reg:
    maxItems: 1

  iso-syscon: true

  nvmem-cells: true

  nvmem-cell-names: true

required:
  - compatible
  - reg

additionalProperties: false

examples:
  - |
    chip-info@1801a200 {
        compatible = "realtek,rtd1195-chip";
        reg = <0x1801a200 0x8>;
    };
  - |
    chip-info@9801a200 {
        compatible = "realtek,rtd1195-chip";
        reg = <0x9801a200 0x8>;
        iso-syscon = <&iso>;
    };
  - |
    chip-info@9801a200 {
        compatible = "realtek,rtd1195-chip";
        reg = <0x9801a200 0x8>;
        iso-syscon = <&iso>;
        nvmem-cells = <&efuse_package_id>;
        nvmem-cell-names = "efuse_package_id";
    };
...
```

## Documentation/devicetree/bindings/usb/fujitsu-phy.txt
```
FUJITSU USB PHY

MB86S7x USB2 PHY

Required properties:
 - compatible: Should be "fujitsu,phy-mb86s70-usb2"
 - reg : Address and length of the register set for the device.
 - interrupts : number of GIC interrupt.

usb2phy: usb2phy@32200000 {
	compatible = "fujitsu,phy-mb86s70-usb2";
	reg = <0 0x32200000 0x100000>;
	interrupts = <0 292 0x4>,
	             <0 294 0x4>;
};

MB86S7x USB3 PHY

Required properties:
 - compatible: Should be "fujitsu,phy-mb86s70-usb3"
 - reg : Address and length of the register set for the device.
 - interrupts : number of GIC interrupt.

usb3phy: usb3phy@32200000 {
	compatible = "fujitsu,phy-mb86s70-usb3";
	reg = <0 0x32200000 0x100000>;
	interrupts = <0 292 0x4>,
	             <0 294 0x4>;
};
```
