## arch/arm/mach-mb86s7x/Kconfig
```kconfig
config ARCH_MB86S7X
	bool "Socionext MB86S7x SoCs"
	depends on ARCH_MULTI_V7
	select ARM_AMBA
	select ARM_GLOBAL_TIMER
	select ARM_GIC
	select HAVE_ARM_SCU
	select HAVE_ARM_TWD if SMP
	help
	  Support for MB86S71 SoC family developed by Socionext Inc.
```

## arch/arm/mach-mb8ac0300/Kconfig
```kconfig
config ARCH_MB8AC0300
	bool "Fujitsu Semiconductor MB8AC0300" if ARCH_MULTI_V7
	select ARM_GIC
	select ARM_GLOBAL_TIMER
	select ARM_TIMER_SP804
	select CLKDEV_LOOKUP
	select CLKSRC_OF
	select COMMON_CLK
	select GENERIC_CLOCKEVENTS
	select GENERIC_TIME
	select HAVE_ARM_SCU if SMP
	select HAVE_ARM_TWD if LOCAL_TIMERS
	select HAVE_SCHED_CLOCK
	select HAVE_SMP
	select MB8AC0300_EXIU
	select MIGHT_HAVE_CACHE_L2X0
	select SPARSE_IRQ
	select HAVE_ARM_SCU
	select HAVE_ARM_TWD
	select ARCH_ENABLE_MEMORY_HOTPLUG
	help
	  Support for Fujitsu Semiconductor's MB8AC0300 based systems.
```

## arch/arm/mach-rda/Kconfig
```kconfig
menuconfig ARCH_RDA
	bool "RDA Micro SoCs"
	depends on ARCH_MULTI_V7
	select COMMON_CLK
	select GENERIC_IRQ_CHIP
	help
	  This enables support for the RDA Micro 8810PL SoC family.
```

## arch/arm/mach-sunplus/Kconfig
```kconfig
# SPDX-License-Identifier: GPL-2.0
menuconfig ARCH_SUNPLUS
	bool "Sunplus SoCs"
	depends on ARCH_MULTI_V7
	select ARM_GIC
	select ARM_GLOBAL_TIMER
	select CLKSRC_ARM_GLOBAL_TIMER_SCHED_CLOCK
	select GENERIC_IRQ_CHIP
	help
	  This enables support for the Sunplus Plus1 (SP7021) SoC family.
```

## drivers/char/mipi_lli/Kconfig
```kconfig
#
# MB86S70 MIPI_LLI device configuration
#

menu "MB86S70 MIPI_LLI devices"
	depends on ARCH_MB86S70 && MIPILLI

config MB86S70_MIPILLI
	depends on ARCH_MB86S70 && MIPILLI
	tristate "MB86S70 MIPILLI"
	help
	  MB86S70 MIPI-LLI SUPPLY, dirver for Fujitsu MIPI-LLI IP,
	  selected if MB86S70 platform is defined.
	  main function is to locally allocate a remote memory
	  on another board via MIPI-LLI interface, this allocated
	  memory can be used by usr-land application.
endmenu
```

## drivers/gpu/drm/fujitsu/Kconfig
```kconfig
config DRM_FUJITSU
	bool

config DRM_FUJITSU_FDB
	tristate "Fujitsu FDB DRM"
	depends on DRM
	depends on ARCH_MB8AC0300 || ARCH_MULTIPLATFORM
	select DRM_FUJITSU
	select DRM_KMS_HELPER
	select FB_SYS_FILLRECT
	select FB_SYS_COPYAREA
	select FB_SYS_IMAGEBLIT
	select FB_SYS_FOPS
	default n
	help
	  DRM display driver for Fujitsu MB8AC0300
```

## drivers/gpu/kds/Kconfig
```kconfig
config KDS
	tristate "Arm Mali Kernel Dependency System"
	default n
	help
	  Mali Kernel Dependency System
```

## drivers/gpu/mali-t6xx/Kconfig
```kconfig
menuconfig ENABLE_MALI_T6XX
	bool "Mali-T6XX series support"
	default n
	help
	  Enable this option to build support for a ARM Mali-T6XX GPU

if ENABLE_MALI_T6XX
choice
	prompt "Mali driver version"
	default MALI_T6XX_VERSION_R9P0
	help
	  Select the Mali driver version

config MALI_T6XX_VERSION_R3P0
	bool "Mali-T6XX R3P0 version"
	help
	  Enable building Mali T6XX R3P0 version
	if MALI_T6XX_VERSION_R3P0
		source "drivers/gpu/mali-t6xx/r3p0/Kconfig"
	endif


config MALI_T6XX_VERSION_R4P1
	bool "Mali-T6XX R4P1 version"
	help
	  Enable building Mali T6XX R4P1 version
	if MALI_T6XX_VERSION_R4P1
		source "drivers/gpu/mali-t6xx/r4p1/Kconfig"
	endif


config MALI_T6XX_VERSION_R9P0
	bool "Mali-T6XX R9P0 version"
	help
	  Enable building Mali T6XX R9P0 version
	if MALI_T6XX_VERSION_R9P0
		source "drivers/gpu/mali-t6xx/r9p0/Kconfig"
	endif

endchoice
endif # ENABLE_MALI_T6XX

menu "Mali Platform configuration"
if MALI_T6XX_VERSION_R3P0 || MALI_T6XX_VERSION_R4P1 || MALI_T6XX_VERSION_R9P0
choice
	prompt "Platform configuration"
	default MALI_PLATFORM_THIRDPARTY
	depends on MALI_EXPERT
	help
	  Select the SOC platform that contains a Mali-T6XX

config MALI_PLATFORM_DEVICETREE
	bool "Device Tree platform"
	depends on OF && MALI_T6XX_VERSION_R9P0
	help
	  Select this option to use Device Tree with the Mali driver.

	  When using this option the Mali driver will get the details of the
	  GPU hardware from the Device Tree. This means that the same driver
	  binary can run on multiple platforms as long as all the GPU hardware
	  details are described in the device tree.

	  Device Tree is the recommended method for the Mali driver platform
	  integration.

config MALI_PLATFORM_VEXPRESS
	depends on ARCH_VEXPRESS && (ARCH_VEXPRESS_CA9X4 || ARCH_VEXPRESS_CA15X4)
	bool "Versatile Express"
config MALI_PLATFORM_VEXPRESS_VIRTEX7_40MHZ
	depends on ARCH_VEXPRESS && (ARCH_VEXPRESS_CA9X4 || ARCH_VEXPRESS_CA15X4) && MALI_T6XX_VERSION_R9P0
	bool "Versatile Express w/Virtex7 @ 40Mhz"
config MALI_PLATFORM_GOLDFISH
	depends on ARCH_GOLDFISH
	bool "Android Goldfish virtual CPU"
config MALI_PLATFORM_PBX
	depends on ARCH_REALVIEW && REALVIEW_EB_A9MP && MACH_REALVIEW_PBX
	bool "Realview PBX-A9"
config MALI_PLATFORM_THIRDPARTY
	bool "Third Party Platform"
endchoice
endif # MALI_T6XX_VERSION_R3P0 || MALI_T6XX_VERSION_R4P1 || MALI_T6XX_VERSION_R9P0
endmenu
```

## drivers/gpu/mali-t6xx/r3p0/Kconfig
```kconfig
#
# (C) COPYRIGHT 2012 ARM Limited. All rights reserved.
#
# This program is free software and is provided to you under the terms of the
# GNU General Public License version 2 as published by the Free Software
# Foundation, and any use by you of this program is subject to the terms
# of such GNU licence.
#
# A copy of the licence is included with the program, and can also be obtained
# from Free Software Foundation, Inc., 51 Franklin Street, Fifth Floor,
# Boston, MA  02110-1301, USA.
#
#


menuconfig MALI_T6XX
	tristate "Mali-T6XX support"
	default n
	depends on MALI_T6XX_VERSION_R3P0
	help
	  Enable this option to build support for the ARM Mali-T6XX GPU.

	  To compile this driver as a module, choose M here:
	  this will generate a single module, called mali_kbase.

config MALI_GATOR_SUPPORT
	bool "Streamline Debug support"
	depends on MALI_T6XX
	default n
	help
	  Adds diagnostic support for use with the ARM Streamline Performance Analyzer.
	  You will need the Gator device driver already loaded before loading this driver when enabling
	  Streamline debug support.

config MALI_T6XX_DVFS
	bool "Enable DVFS"
	depends on MALI_T6XX
	default n
	help
	  Choose this option to enable DVFS on MALI T6XX DDK.

config MALI_T6XX_RT_PM
	bool "Enable Runtime power management"
	depends on MALI_T6XX
	depends on PM_RUNTIME
	default n
	help
	  Choose this option to enable runtime power management on MALI T6XX DDK.

config MALI_T6XX_ENABLE_TRACE
       bool "Enable kbase tracing"
       depends on MALI_T6XX
       default n
       help
         Enables tracing in kbase.  Trace log available through
	 the "mali_trace" debugfs file, when the CONFIG_DEBUG_FS is enabled

config MALI_T6XX_DEBUG_SYS
       bool "Enable sysfs for mali t6xx"
       depends on MALI_T6XX && SYSFS
       default n
       help
         Enables sysfs for mali t6xx device. Set/Monitor Mali T6xx Device

# MALI_EXPERT configuration options

menuconfig MALI_EXPERT
	depends on MALI_T6XX
	bool "Enable Expert Settings"
	default n
	help
	  Enabling this option and modifying the default settings may produce a driver with performance or
	  other limitations.

config MALI_DEBUG_SHADER_SPLIT_FS
	bool "Allow mapping of shader cores via sysfs"
	depends on MALI_T6XX && MALI_T6XX_DEBUG_SYS && MALI_EXPERT
	default n
	help
	  Select this option to provide a sysfs entry for runtime configuration of shader
	  core affinity masks.

config MALI_PLATFORM_THIRDPARTY_NAME
	depends on MALI_T6XX && MALI_PLATFORM_THIRDPARTY && MALI_EXPERT
	string "Third party platform name"
	help
	  Enter the name of a third party platform that is supported. The third part configuration
	  file must be in kbase/src/linux/config/tpip/mali_kbase_config_xxx.c where xxx is the name
	  specified here.

config MALI_DEBUG
	bool "Debug build"
	depends on MALI_T6XX && MALI_EXPERT
	default n
	help
	  Select this option for increased checking and reporting of errors.

config MALI_ERROR_INJECT
	bool "Error injection"
	depends on MALI_T6XX && MALI_EXPERT && MALI_NO_MALI
	default n
	help
	  Enables insertion of errors to test module failure and recovery mechanisms.

config MALI_TRACE_TIMELINE
	bool "Timeline tracing"
	depends on MALI_T6XX && MALI_EXPERT
	default n
	help
	  Enables timeline tracing through the kernel tracepoint system.

config MALI_SYSTEM_TRACE
	bool "Enable system event tracing support"
	depends on MALI_T6XX && MALI_EXPERT
	default n
	help
	  Choose this option to enable system trace events for each
	  kbase event.	This is typically used for debugging but has
	  minimal overhead when not in use. Enable only if you know what
	  you are doing.

source "drivers/gpu/mali-t6xx/r3p0/src/platform/Kconfig"
```

## drivers/gpu/ump/Kconfig
```kconfig
config UMP
	tristate "Arm Mali Memory Allocator"
	help
	  Mali Kernel Memory Allocator
```

## drivers/net/ethernet/fujitsu/Kconfig
```kconfig
#
# Fujitsu Network device configuration
#

config NET_VENDOR_FUJITSU
	bool "Fujitsu devices"
	default y
	depends on ISA || PCMCIA || ARCH_MB8AC0300 || ARCH_MB86S70
	---help---
	  If you have a network (Ethernet) card belonging to this class, say Y
	  and read the Ethernet-HOWTO, available from
	  <http://www.tldp.org/docs.html#howto>.

	  Note that the answer to this question doesn't directly affect the
	  the questions about Fujitsu cards. If you say Y, you will be asked for
	  your specific card in the following questions.

if NET_VENDOR_FUJITSU

config PCMCIA_FMVJ18X
	tristate "Fujitsu FMV-J18x PCMCIA support"
	depends on PCMCIA
	select CRC32
	---help---
	  Say Y here if you intend to attach a Fujitsu FMV-J18x or compatible
	  PCMCIA (PC-card) Ethernet card to your computer.

	  To compile this driver as a module, choose M here: the module will be
	  called fmvj18x_cs.  If unsure, say N.

config FGMAC4
	tristate "FUJITSU F_GMAC4 support"
	select CRC32
	select MII
	select PHYLIB
	depends on ARCH_MB8AC0300 || ARCH_MB86S70
	default m
	help
	  This is the driver for the Ethernet interface on the
	  FUJITSU ARM SoC
	  Platform. If you have the FUJITSU ARM SoC Platform, say Y or M here.
	  If unsure, say N.

config FGMAC4_ANEG
	bool "Fujitsu F_GMAC4 Autonegotiation"
	depends on FGMAC4
	default y
	help
	  Select this to allow the FGMA4 PHY to autonegotiate the speed
	  and duplex state. If you leave this off, it will default to a
	  fixed 100Mbps duplex connection no matter what you actually
	  connect it to.  You probably want to enable it.

config FGMAC4_ALT_DESC
	bool "Alternate or Enhanced Descriptors"
	depends on FGMAC4
	default n
	help
	  Say 'y' here if F_GMAC4 IP on your SoC uses
	  Alternate or Enhanced Descriptors.
	  This kind of descriptor is valid
	  Only for F_GMAC4(M)T IP

config FGMAC4_TDESC_NUM
	int "Number of transmit buffers"
	depends on FGMAC4
	range 19 256
	default "256"
	help
	  Set the number of transmit buffers used in driver.

config FGMAC4_RDESC_NUM
	int "Number of receive buffers"
	depends on FGMAC4
	range 1 256
	default "256"
	help
	  Set the number of received buffers used in driver.

config FGMAC4_BUFFER_SIZE
	int "Size of one transmit or receive buffer"
	depends on FGMAC4
	range 1536 9024
	default "1536"
help
	  Set the size of one transmit or receive buffer used in driver.
	  The buffer size must be in multiples of cache line size(32).
	  If jumbo frames are to be used, a large number is recommended, and
	  otherwise, default value is ok.

config FGMAC4_USE_BOUNCE_BUF
	bool "Use bounce buffers"
	depends on FGMAC4
	default n

config F_TAIKI
	tristate "F_TAIKI network support"
help
	  Enable for F_TAIKI support of FGAMC4 IP
	  Provides Gigabit ethernet support with low power mode

endif # NET_VENDOR_FUJITSU
```

## drivers/net/fsk/Kconfig
```kconfig
#
# FSK
#

menu "FSK Device Drivers"

#
# Alphabetically sorted.
#

config FSK_CC1120
	tristate "TI CC1120 driver"
	default y
	depends on SPI
	help
	  TI CC1120

config FSK_MRF89XA
	tristate "Microchip MRF89XA driver"
	default y
	depends on SPI
	help
	  Microchip MRF89XA

config FSK_NRF24L01P
	tristate "Nordic nRF24L01+ driver"
	default y
	depends on SPI
	help
	  Nordic Semiconductor nRF24L01+

config FSK_SI443X
	tristate "SiLabs Si443x driver"
	default y
	depends on SPI
	help
	  Silicon Labs Si4432

config FSK_S2LP
	tristate "ST S2-LP driver"
	default y
	depends on SPI
	help
	  ST S2-LP

endmenu
```

## drivers/net/lorawan/Kconfig
```kconfig
#
# LoRaWAN
#

menu "LoRaWAN Device Drivers"

#
# Alphabetically sorted.
#

config LORAWAN_GMX_LR1
	tristate "Gimasi GMX-LR1 driver"
	default y
	depends on SERIAL_DEV_BUS
	help
	  Gimasi GMX-LR1

config LORAWAN_RM1XX
	tristate "Laird RM1xx driver"
	default y
	depends on SERIAL_DEV_BUS
	help
	  Laird Technologies RM1xx

endmenu
```

## drivers/pci/host/Kconfig
```kconfig
menu "PCI host controller drivers"
	depends on PCI

config PCIE_F_PCIE2_DMXH
	tristate "Fujitsu f_pcie2_dmxh Support"
	depends on PCI && (ARCH_MB8AC0300 || ARCH_MB86S70)
	default y
	help
	  Say Y here if you want to enable
	  Fujitsu F_PCIE2_DMXH PCIe root complex
	  support.
	  If unsure say Y.

config SYSOC_F_PCIE_PCIE2_DMXH
	tristate "Fujitsu F_PCIE2_DMXH System control Support"
	depends on PCIE_F_PCIE2_DMXH
	default y
	help
	  Say Y here if you want to enable
	  Fujitsu F_PCIE2_DMXH System control Support.
	  If unsure say Y.

config PCI_MVEBU
	bool "Marvell EBU PCIe controller"
	depends on ARCH_MVEBU || ARCH_KIRKWOOD

config PCIE_DW
	bool

config PCI_EXYNOS
	bool "Samsung Exynos PCIe controller"
	depends on SOC_EXYNOS5440
	select PCIEPORTBUS
	select PCIE_DW

endmenu
```

## drivers/pinctrl/realtek/Kconfig
```kconfig
# SPDX-License-Identifier: GPL-2.0-only

config PINCTRL_REALTEK_DHC
	bool "Realtek DHC pinctrl driver"
	depends on OF
	depends on ARCH_REALTEK || COMPILE_TEST
	select GENERIC_PINCONF
	select PINMUX
	help
	  This is the pinctrl, pinmux, pinconf driver for
	  Realtek DHC SoC platforms.
```

## drivers/pinctrl/xmc4000/Kconfig
```kconfig
if ARCH_XMC4000 || COMPILE_TEST

config PINCTRL_XMC4000
	bool
	depends on OF
	select PINMUX
	select GENERIC_PINCONF
	select GPIOLIB

config PINCTRL_XMC4500
	bool "Pinctrl driver for Infineon XMC4500" if COMPILE_TEST && !MACH_XMC4500
	depends on OF
	default ARCH_XMC4000
	select PINCTRL_XMC4000

endif
```

## drivers/soc/realtek/Kconfig
```kconfig
# SPDX-License-Identifier: GPL-2.0-or-later
if ARCH_REALTEK || COMPILE_TEST

config REALTEK_SOC
	tristate "Realtek chip info"
	default ARCH_REALTEK
	select SOC_BUS
	help
	  Say 'y' here to enable support for SoC info on Realtek RTD1195 and
	  RTD1295 SoC families.
	  If unsure, say 'n'.

config REALTEK_SB2
	bool "Realtek SB2"
	default ARCH_REALTEK
	help
	  Say 'y' here to enable support for SB2 on Realtek RTD1195 and
	  RTD1295 SoC families.
	  If unsure, say 'n'.

config REALTEK_SCPU
	bool "Realtek SCPU Wrapper"
	default ARCH_REALTEK
	help
	  Say 'y' here to enable support for SCPU Wrapper on Realtek RTD1195
	  and RTD1295 SoC families.
	  If unsure, say 'n'.

config REALTEK_PM_DOMAINS
	bool "Realtek power domains"
	depends on PM
	select PM_GENERIC_DOMAINS
	help
	  Say 'y' here to enable support for powerctrl on Realtek RTD1295 SoC.
	  If unsure, say 'n'.

endif
```
