## Documentation/devicetree/bindings/usb/fujitsu-usb.txt
```
FUJITSU GLUE AND OTHER SPECIFIC COMPONENTS

F_USB20HDC USB DUAL-ROLE CONTROLLER
 - compatible : Should be "fujitsu,f_usb20hdc_otg"
 - reg : Address and length of the register set for the device.
 - interrupts : The irq number of this device that is used to interrupt the
   CPU
 - dma_dreq : handle to use "fujitsu,mb8ac0300-hdmac" DMA controller.
 - hdmac_channel : handle to use "fujitsu,mb8ac0300-hdmac" DMA controller.
 - clocks: from common clock binding, handle to usb clock.
 - clock-names: from common clock binding.
 - #stream-id-cells : handle to use "arm,mmu-400" ARM IOMMU driver

usb2otg: usb2otg@0x34000000 {
	compatible = "fujitsu,f_usb20hdc_otg";
	reg = <0 0x34000000 0x10000>;
	interrupts = <0 296 0x4>;
	dma_dreq = <0x10000000 0x11000000>;
	hdmac_channel = <0 1>;
	clocks = <&clk_main_2_3>;
	clock-names = "h_clk";
	#stream-id-cells = <0>;
};


MB86S7x DWC3 GLUE
 - compatible : Should be "fujitsu,mb86s70-dwc3"
 - clocks: from common clock binding, handle to usb clock.
 - clock-names: from common clock binding.
 - #address-cells, #size-cells : Must be present if the device has sub-nodes
 - ranges: the child address space are mapped 1:1 onto the parent address space
 - #stream-id-cells : handle to use "arm,mmu-400" ARM IOMMU driver

Sub-nodes:
The dwc3 core should be added as subnode to MB86S7x dwc3 glue.
- dwc3 :
   The binding details of dwc3 can be found in:
   Documentation/devicetree/bindings/usb/dwc3.txt

usb3host: mb86s70_usb3host {
	compatible = "fujitsu,mb86s70-dwc3";
	clocks = <&clk_alw_1_1>;
	clock-names = "bus_clk";
	#address-cells = <2>;
	#size-cells = <1>;
	ranges;
	#stream-id-cells = <0>;
};


MB86S7x EHCI GLUE
 - compatible : Should be "fujitsu,f_usb20ho_hcd"
 - reg : Address and length of the register set for the device.
 - interrupts : The irq number of this device that is used to interrupt the
   CPU
 - clocks: from common clock binding, handle to usb clock.
 - clock-names: from common clock binding.
 - #stream-id-cells : handle to use "arm,mmu-400" ARM IOMMU driver
 - fujitsu,power-domain : pd_usb2h node has to be builded, details can be
   found in:
   Documentation/devicetree/bindings/

hcd21: f_usb20ho_hcd {
	compatible = "fujitsu,f_usb20ho_hcd";
	reg = <0 0x34200000 0x80000>;
	interrupts = <0 419 0x4>;
	clocks = <&clk_main_2_4>, <&clk_main_4_5>, <&clk_usb_0_0>;
	clock-names = "h_clk", "p_clk", "p_cryclk";
	#stream-id-cells = <0>;
	fujitsu,power-domain = <&pd_usb2h>;
};
```

## Documentation/devicetree/bindings/video/backlight/apnet-b01.txt
```
Alpha Project B01 panel backlight

Backlights part of the combined backlight / touchpanel

Required properties:
- compatible: "apnet,b01-bl"
- reg: I2C slave address
- backlight: node for specifying WLED1 and WLED2 lines in TPS65217
- isel: selection bit, valid values: 1 for ISEL1 (low-level) and 2 for ISEL2 (high-level)
- fdim: PWM dimming frequency, valid values: 100, 200, 500, 1000
- default-brightness: valid values: 0-100

Each regulator is defined using the standard binding for regulators.

Example:

	bl01: bl01@24 {
		reg = <0x42>;
		compatible = "apnet,b01-bl";
		backlight {
			isel = <1>;  /* 1 - ISET1, 2 ISET2 */
			fdim = <100>; /* TPS65217_BL_FDIM_100HZ */
			default-brightness = <50>;
		};
	};
```

## Documentation/devicetree/bindings/video/backlight/pwm-backlight.txt
```
pwm-backlight bindings

Required properties:
  - compatible: "pwm-backlight"
  - pwms: OF device-tree PWM specification (see PWM binding[0])
  - brightness-levels: Array of distinct brightness levels. Typically these
      are in the range from 0 to 255, but any range starting at 0 will do.
      The actual brightness level (PWM duty cycle) will be interpolated
      from these values. 0 means a 0% duty cycle (darkest/off), while the
      last value in the array represents a 100% duty cycle (brightest).
  - default-brightness-level: the default brightness level (index into the
      array defined by the "brightness-levels" property)

Optional properties:
  - pwm-names: a list of names for the PWM devices specified in the
               "pwms" property (see PWM binding[0])
  - gpios:     An arbitrary number of gpios that must be asserted when the
               backlight is on, and de-asserted when off.  They will be asserted
               in the order they appear, and de-asserted in reverse order.

[0]: Documentation/devicetree/bindings/pwm/pwm.txt

Example:

	backlight {
		compatible = "pwm-backlight";
		pwms = <&pwm 0 5000000>;

		brightness-levels = <0 4 8 16 32 64 128 255>;
		default-brightness-level = <6>;
		gpios = <&gpio 77 0>, <&gpio 25 1>;  /* gpio 25 is active low */
	};
```

## Documentation/devicetree/bindings/watchdog/realtek,rtd1195.yaml
```yaml
# SPDX-License-Identifier: (GPL-2.0-or-later OR BSD-2-Clause)
%YAML 1.2
---
$id: "http://devicetree.org/schemas/watchdog/realtek,rtd1195.yaml#"
$schema: "http://devicetree.org/meta-schemas/core.yaml#"

title: Realtek RTD1295 Watchdog

maintainers:
  - Andreas Färber <afaerber@suse.de>

allOf:
  - $ref: watchdog.yaml#

properties:
  compatible:
    oneOf:
      - const: realtek,rtd1295-watchdog

  reg:
    maxItems: 1

  clocks:
    maxItems: 1

required:
  - compatible
  - reg
  - clocks

examples:
  - |
    watchdog@98007680 {
        compatible = "realtek,rtd1295-watchdog";
        reg = <0x98007680 0x100>;
        clocks = <&osc27M>;
    };
...
```

## arch/arm/configs/greenboard_defconfig
```kconfig
# CONFIG_LOCALVERSION_AUTO is not set
CONFIG_DEFAULT_HOSTNAME="mb8ac0300"
CONFIG_SYSVIPC=y
CONFIG_POSIX_MQUEUE=y
CONFIG_NO_HZ=y
CONFIG_HIGH_RES_TIMERS=y
CONFIG_CGROUPS=y
CONFIG_CGROUP_SCHED=y
CONFIG_NAMESPACES=y
CONFIG_BLK_DEV_INITRD=y
CONFIG_RD_BZIP2=y
CONFIG_RD_LZMA=y
CONFIG_RD_XZ=y
CONFIG_RD_LZO=y
CONFIG_CC_OPTIMIZE_FOR_SIZE=y
CONFIG_EXPERT=y
# CONFIG_COMPAT_BRK is not set
CONFIG_SLAB=y
CONFIG_PROFILING=y
CONFIG_MODULES=y
CONFIG_MODULE_UNLOAD=y
CONFIG_KEYBOARD_GPIO_POLLED=y
CONFIG_ARCH_MB8AC0300=y
CONFIG_ARCH_MB86S70=y
CONFIG_ARM_LPAE=y
# CONFIG_SWP_EMULATE is not set
CONFIG_ARM_ERRATA_754322=y
CONFIG_ARM_ERRATA_754327=y
CONFIG_ARM_ERRATA_764369=y
CONFIG_ARM_ERRATA_775420=y
CONFIG_ARM_ERRATA_798181=y
CONFIG_PCI=y
CONFIG_ARCH_SUPPORTS_MSI=y
CONFIG_PCI_MSI=y
CONFIG_PCIE_F_PCIE2_DMXH=m
CONFIG_PCIEASPM_POWERSAVE=y
CONFIG_SMP=y
CONFIG_SCHED_MC=y
CONFIG_SCHED_SMT=y
CONFIG_BL_SWITCHER=y
CONFIG_BL_SWITCHER_DUMMY_IF=m
CONFIG_DISABLE_CPU_SCHED_DOMAIN_BALANCE=y
CONFIG_SCHED_HMP=y
# CONFIG_SCHED_HMP_PRIO_FILTER is not set
CONFIG_HMP_FAST_CPU_MASK=""
CONFIG_HMP_SLOW_CPU_MASK=""
CONFIG_HMP_VARIABLE_SCALE=y
CONFIG_HMP_FREQUENCY_INVARIANT_SCALE=y
CONFIG_SCHED_HMP_LITTLE_PACKING=y
CONFIG_VMSPLIT_2G=y
CONFIG_PREEMPT=y
CONFIG_THUMB2_KERNEL=y
CONFIG_HIGHMEM=y
CONFIG_CMA=y
# CONFIG_ATAGS is not set
CONFIG_ZBOOT_ROM_TEXT=0x0
CONFIG_ZBOOT_ROM_BSS=0x0
CONFIG_CMDLINE="mem=2048M earlycon=ttyS0,115200 earlyprintk console=ttyS0,115200 console=tty0 root=/dev/mmcblk0p2 rootfstype=ext4 rootwait"
CONFIG_KEXEC=y
CONFIG_CPU_FREQ=y
CONFIG_CPU_FREQ_DEFAULT_GOV_ONDEMAND=y
CONFIG_ARM_BIG_LITTLE_CPUFREQ=y
CONFIG_ARM_DT_BL_CPUFREQ=m
CONFIG_CPU_IDLE=y
CONFIG_ARM_BIG_LITTLE_CPUIDLE=y
CONFIG_VFP=y
CONFIG_NEON=y
CONFIG_PM_WAKELOCKS=y
CONFIG_PM_RUNTIME=y
CONFIG_PM_DEBUG=y
CONFIG_NET=y
CONFIG_PACKET=y
CONFIG_UNIX=y
CONFIG_INET=y
CONFIG_IP_MULTICAST=y
CONFIG_IP_PNP=y
CONFIG_IP_PNP_DHCP=y
CONFIG_IP_PNP_BOOTP=y
# CONFIG_INET_XFRM_MODE_TRANSPORT is not set
# CONFIG_INET_XFRM_MODE_TUNNEL is not set
# CONFIG_INET_XFRM_MODE_BEET is not set
# CONFIG_INET_LRO is not set
CONFIG_IPV6=y
CONFIG_INET6_XFRM_MODE_TRANSPORT=m
CONFIG_INET6_XFRM_MODE_TUNNEL=m
CONFIG_INET6_XFRM_MODE_BEET=m
CONFIG_IPV6_SIT=m
# CONFIG_ANDROID_PARANOID_NETWORK is not set
CONFIG_DEVTMPFS=y
CONFIG_DEVTMPFS_MOUNT=y
CONFIG_DMA_SHARED_BUFFER=y
CONFIG_DMA_SHARED_BUFFER_USES_KDS=y
CONFIG_DMA_CMA=y
CONFIG_CMA_SIZE_MBYTES=512
CONFIG_MTD=y
CONFIG_MTD_CMDLINE_PARTS=y
CONFIG_MTD_BLOCK=y
CONFIG_MTD_CFI=y
CONFIG_MTD_CFI_ADV_OPTIONS=y
CONFIG_MTD_CFI_AMDSTD=y
CONFIG_MTD_ROM=y
CONFIG_MTD_COMPLEX_MAPPINGS=y
CONFIG_MTD_PHYSMAP=y
CONFIG_MTD_PHYSMAP_OF=y
CONFIG_MTD_PLATRAM=y
CONFIG_MTD_M25P80=y
CONFIG_MTD_HS_SPI_FLASH=y
CONFIG_MTD_GPIO_NOR=m
CONFIG_MTD_SPI_NOR=y
CONFIG_PROC_DEVICETREE=y
CONFIG_BLK_DEV_LOOP=m
CONFIG_BLK_DEV_CRYPTOLOOP=m
CONFIG_BLK_DEV_RAM=y
CONFIG_BLK_DEV_RAM_COUNT=2
CONFIG_BLK_DEV_RAM_SIZE=1024
CONFIG_FUJITSU_MEDIA_SHELL=m
CONFIG_GPIO_REVISION=y
CONFIG_BLK_DEV_SD=m
CONFIG_ATA=m
# CONFIG_ATA_VERBOSE_ERROR is not set
# CONFIG_SATA_PMP is not set
CONFIG_SATA_AHCI_PLATFORM=m
# CONFIG_ATA_SFF is not set
CONFIG_NETDEVICES=y
CONFIG_F_TAIKI=m
CONFIG_TUN=m
# CONFIG_NET_CADENCE is not set
# CONFIG_NET_VENDOR_BROADCOM is not set
# CONFIG_NET_VENDOR_CIRRUS is not set
# CONFIG_NET_VENDOR_FARADAY is not set
CONFIG_FGMAC4_ALT_DESC=y
CONFIG_FGMAC4_USE_BOUNCE_BUF=y
# CONFIG_NET_VENDOR_INTEL is not set
# CONFIG_NET_VENDOR_MARVELL is not set
# CONFIG_NET_VENDOR_MICREL is not set
# CONFIG_NET_VENDOR_MICROCHIP is not set
# CONFIG_NET_VENDOR_NATSEMI is not set
# CONFIG_NET_VENDOR_SEEQ is not set
# CONFIG_NET_VENDOR_SMSC is not set
# CONFIG_NET_VENDOR_STMICRO is not set
# CONFIG_NET_VENDOR_WIZNET is not set
CONFIG_PHYLIB=y
CONFIG_USB_USBNET=m
# CONFIG_INPUT_MOUSEDEV_PSAUX is not set
CONFIG_INPUT_MOUSEDEV_SCREEN_X=800
CONFIG_INPUT_MOUSEDEV_SCREEN_Y=480
CONFIG_INPUT_EVDEV=m
# CONFIG_KEYBOARD_ATKBD is not set
# CONFIG_MOUSE_PS2 is not set
CONFIG_MOUSE_GPIO=m
CONFIG_INPUT_TOUCHSCREEN=y
CONFIG_TOUCHSCREEN_EGALAX=m
CONFIG_TOUCHSCREEN_ILI210X=m
CONFIG_TOUCHSCREEN_MB8AC0300=m
CONFIG_TOUCHSCREEN_TPCONTROLLERJ4=y
# CONFIG_SERIO_SERPORT is not set
CONFIG_LEGACY_PTY_COUNT=16
# CONFIG_DEVKMEM is not set
CONFIG_SERIAL_8250=y
# CONFIG_SERIAL_8250_DEPRECATED_OPTIONS is not set
CONFIG_SERIAL_8250_CONSOLE=y
CONFIG_SERIAL_8250_EXTENDED=y
CONFIG_SERIAL_8250_DW=y
CONFIG_SERIAL_AMBA_PL011=y
CONFIG_SERIAL_AMBA_PL011_CONSOLE=y
CONFIG_SERIAL_OF_PLATFORM=y
CONFIG_SERIAL_SC16IS7XX_CORE=y
CONFIG_SERIAL_SC16IS7XX=y
CONFIG_SERIAL_SC16IS7XX_I2C=y
# CONFIG_HW_RANDOM is not set
CONFIG_MIPILLI=m
CONFIG_MB86S70_MIPILLI=m
CONFIG_I2C_CHARDEV=m
CONFIG_I2C_F_I2C=y
CONFIG_SPI=y
CONFIG_HS_SPI=y
CONFIG_GPIO_SYSFS=y
CONFIG_GPIO_MB86S7X=y
CONFIG_GPIO_MB8AC0300=y
CONFIG_GPIO_MCP23S08=m
CONFIG_SENSORS_AMC6821=y
CONFIG_THERMAL=y
CONFIG_CPU_THERMAL=y
CONFIG_THERMAL_EMULATION=y
CONFIG_MB86S7X_THERMAL=y
CONFIG_REGULATOR=y
CONFIG_REGULATOR_GPIO=y
CONFIG_MEDIA_SUPPORT=y
CONFIG_MEDIA_CAMERA_SUPPORT=y
CONFIG_MEDIA_USB_SUPPORT=y
CONFIG_USB_VIDEO_CLASS=m
# CONFIG_VGA_ARB is not set
CONFIG_DRM=y
CONFIG_DRM_FUJITSU_FDB=y
CONFIG_FIRMWARE_EDID=y
CONFIG_FB_MODE_HELPERS=y
CONFIG_FB_TILEBLITTING=y
CONFIG_FB_FUJITSU_FDB=y
CONFIG_FB_PICAPDC=y
CONFIG_FB_MB86S70=y
CONFIG_F_MIPIDSI1_LP=y
CONFIG_F_HDMI_TX14=y
CONFIG_F_FPDL_TX=y
CONFIG_SN65DSI84=y
CONFIG_BACKLIGHT_LCD_SUPPORT=y
CONFIG_LCD_CLASS_DEVICE=y
CONFIG_BACKLIGHT_CLASS_DEVICE=y
CONFIG_BACKLIGHT_PWM=y
CONFIG_BACKLIGHT_APNET_B01=y
CONFIG_BACKLIGHT_GPIO=y
CONFIG_FRAMEBUFFER_CONSOLE=y
CONFIG_FRAMEBUFFER_CONSOLE_DETECT_PRIMARY=y
CONFIG_FRAMEBUFFER_CONSOLE_ROTATION=y
CONFIG_FONTS=y
CONFIG_FONT_SUN8x16=y
CONFIG_LOGO=y
# CONFIG_LOGO_LINUX_MONO is not set
# CONFIG_LOGO_LINUX_VGA16 is not set
CONFIG_SOUND=m
CONFIG_SND=m
CONFIG_SND_DYNAMIC_MINORS=y
# CONFIG_SND_SUPPORT_OLD_API is not set
# CONFIG_SND_VERBOSE_PROCFS is not set
CONFIG_SND_DEBUG=y
CONFIG_SND_DEBUG_VERBOSE=y
# CONFIG_SND_ARM is not set
# CONFIG_SND_SPI is not set
# CONFIG_SND_USB is not set
CONFIG_SND_SOC=m
CONFIG_F_SAIF_MAX_CH_NUM=6
CONFIG_SND_SOC_MB8AC0300_ADAU1361=m
# CONFIG_SND_SOC_MB86S70_WM8973 is not set
CONFIG_SND_SOC_MB86S70_HDMI=m
CONFIG_HID=m
CONFIG_HID_A4TECH=m
CONFIG_HID_APPLE=m
CONFIG_HID_BELKIN=m
CONFIG_HID_CHERRY=m
CONFIG_HID_CHICONY=m
CONFIG_HID_CYPRESS=m
CONFIG_HID_EZKEY=m
CONFIG_HID_KENSINGTON=m
CONFIG_HID_LOGITECH=m
CONFIG_HID_MICROSOFT=m
CONFIG_HID_MONTEREY=m
CONFIG_HID_PID=y
CONFIG_USB_HIDDEV=y
CONFIG_USB=m
CONFIG_USB_OTG=y
CONFIG_USB_XHCI_HCD=m
CONFIG_USB_EHCI_HCD=m
CONFIG_USB_EHCI_HCD_PLATFORM=m
CONFIG_USB_OHCI_HCD=m
CONFIG_USB_OHCI_HCD_PLATFORM=y
CONFIG_USB_F_USB20HDC_OTG=m
CONFIG_USB_F_USB20HDC_OTG_GADGET_ONLY=y
# CONFIG_USB_F_USB20HDC_OTG_DUAL_ROLE is not set
CONFIG_USB_ACM=m
CONFIG_USB_STORAGE=m
CONFIG_USB_DWC3=m
CONFIG_USB_DWC3_HOST=y
CONFIG_USB_DWC3_DEBUG=y
CONFIG_USB_PHY=y
CONFIG_USB_GADGET=m
CONFIG_USB_GADGET_F_USB30=y
CONFIG_USB_GADGET_F_USB30_USED_BUS_RESET_DUMMY_DISCONNECT_NOTIFY=y
CONFIG_USB_MASS_STORAGE=m
CONFIG_USB_G_MULTI=m
CONFIG_MMC=y
CONFIG_MMC_UNSAFE_RESUME=y
CONFIG_MMC_CLKGATE=y
CONFIG_MMC_SDHCI=y
CONFIG_MMC_SDHCI_F_SDH30=y
CONFIG_NEW_LEDS=y
CONFIG_LEDS_CLASS=y
CONFIG_LEDS_GPIO=y
CONFIG_LEDS_TRIGGERS=y
CONFIG_LEDS_TRIGGER_TIMER=y
CONFIG_LEDS_TRIGGER_HEARTBEAT=y
CONFIG_LEDS_TRIGGER_BACKLIGHT=m
CONFIG_LEDS_TRIGGER_CPU=y
CONFIG_LEDS_TRIGGER_GPIO=y
CONFIG_LEDS_TRIGGER_DEFAULT_ON=y
CONFIG_LEDS_TRIGGER_TRANSIENT=m
CONFIG_RTC_CLASS=y
CONFIG_RTC_DRV_RS5C372=y
CONFIG_DMADEVICES=y
CONFIG_PL330_DMA=y
CONFIG_DMATEST=m
CONFIG_STAGING=y
CONFIG_ANDROID=y
CONFIG_ANDROID_BINDER_IPC=y
CONFIG_ASHMEM=y
CONFIG_ANDROID_LOGGER=y
CONFIG_ANDROID_TIMED_GPIO=y
CONFIG_ANDROID_LOW_MEMORY_KILLER=y
CONFIG_SYNC=y
CONFIG_ION=y
CONFIG_ION_DUMMY=y
CONFIG_MAILBOX=y
CONFIG_MBOX_F_IPCU=m
CONFIG_MBOX_F_MHU=y
CONFIG_ARM_SMMU=y
CONFIG_PWM=y
CONFIG_ENABLE_MALI_T6XX=y
CONFIG_MALI_EXPERT=y
CONFIG_MALI_PLATFORM_THIRDPARTY_NAME="fujitsu_mb86s70"
CONFIG_MALI_T6XX_VERSION_R9P0=y
CONFIG_MALI_MIDGARD=y
CONFIG_MALI_PLATFORM_FAKE=y
CONFIG_MALI_TIMELINE_DISABLED=y
CONFIG_MALI_PLATFORM_THIRDPARTY=y
CONFIG_EXT4_FS=y
CONFIG_EXT4_FS_POSIX_ACL=y
CONFIG_EXT4_FS_SECURITY=y
CONFIG_VFAT_FS=m
CONFIG_TMPFS=y
CONFIG_JFFS2_FS=m
CONFIG_CRAMFS=y
CONFIG_ROMFS_FS=y
CONFIG_ROMFS_BACKED_BY_BOTH=y
# CONFIG_NETWORK_FILESYSTEMS is not set
CONFIG_NLS_CODEPAGE_437=m
CONFIG_NLS_ISO8859_1=m
CONFIG_PRINTK_TIME=y
CONFIG_MAGIC_SYSRQ=y
# CONFIG_DEBUG_PREEMPT is not set
CONFIG_DEBUG_INFO=y
CONFIG_DEBUG_MEMORY_INIT=y
# CONFIG_RCU_CPU_STALL_VERBOSE is not set
# CONFIG_FTRACE is not set
CONFIG_DEBUG_USER=y
# CONFIG_CRYPTO_ANSI_CPRNG is not set
# CONFIG_CRYPTO_HW is not set
CONFIG_USB_F_USB20HDC_OTG_USE_WAKEUP=y
CONFIG_BT=m
CONFIG_BT_RFCOMM=m
CONFIG_BT_RFCOMM_TTY=y
CONFIG_BT_BNEP=m
CONFIG_BT_BNEP_MC_FILTER=y
CONFIG_BT_BNEP_PROTO_FILTER=y
CONFIG_BT_HIDP=m
CONFIG_BT_HCIUART=m
CONFIG_BT_HCIUART_H4=y
CONFIG_BT_HCIUART_BCSP=y
CONFIG_BT_HCIUART_ATH3K=y
CONFIG_BT_HCIUART_LL=y
CONFIG_BT_HCIUART_3WIRE=y
CONFIG_BT_WILINK=m
CONFIG_WIRELESS=y
CONFIG_WEXT_CORE=y
CONFIG_WEXT_PROC=y
CONFIG_CFG80211=m
CONFIG_NL80211_TESTMODE=y
CONFIG_CFG80211_DEFAULT_PS=y
CONFIG_CFG80211_WEXT=y
CONFIG_MAC80211=m
CONFIG_MAC80211_HAS_RC=y
CONFIG_MAC80211_RC_MINSTREL=y
CONFIG_MAC80211_RC_MINSTREL_HT=y
CONFIG_MAC80211_RC_DEFAULT_MINSTREL=y
CONFIG_MAC80211_RC_DEFAULT="minstrel_ht"
CONFIG_RFKILL=y
CONFIG_RFKILL_PM=y
CONFIG_RFKILL_LEDS=y
CONFIG_FW_LOADER_USER_HELPER=y
CONFIG_TI_ST=m
CONFIG_WLAN=y
CONFIG_WL_TI=y
CONFIG_WL18XX=m
CONFIG_WLCORE=m
CONFIG_WLCORE_SDIO=m
CONFIG_WILINK_PLATFORM_DATA=y
CONFIG_MMC_EMBEDDED_SDIO=y
CONFIG_CRYPTO_ECB=m
CONFIG_CRYPTO_SHA256=m
CONFIG_CRYPTO_ARC4=m
CONFIG_AVERAGE=y
```

## arch/arm/mach-mb86s70/Kconfig
```kconfig
config ARCH_MB86S70
	bool "Fujitsu Semiconductor MB86S70"
	select CPU_V7
	select ARM_AMBA
	select ARM_GIC
#	select ARM_TIMER_SP804
	select ARCH_REQUIRE_GPIOLIB
	select ARCH_HAS_CPUFREQ
	select ARCH_HAS_OPP
	select PM_OPP
	select USB_ARCH_HAS_EHCI
	select USB_ARCH_HAS_XHCI
	select BIG_LITTLE
	select CLKDEV_LOOKUP
	select COMMON_CLK
	select GENERIC_CLOCKEVENTS
	select GENERIC_GPIO
	select HAVE_ARM_ARCH_TIMER
	select HAVE_CLK
	select HAVE_SMP
	select MB8AC0300_EXIU
	select MIGHT_HAVE_CACHE_L2X0
	select ARM_CCI
	select MIGHT_HAVE_PCI
	select PCIEPORTBUS
	select PINCTRL
	select PINCTRL_MB86S70
	select PM_GENERIC_DOMAINS if PM
	select LOCAL_TIMERS
	select ARCH_DMA_ADDR_T_64BIT
	help
	  Support for Fujitsu Semiconductor's systems.
```
