// SPDX-License-Identifier: (GPL-2.0-or-later OR BSD-2-Clause)
/*
 * Realtek RTD1319 SoC
 *
 * Copyright (c) 2019 Realtek Semiconductor Corp.
 */

#include "rtd13xx.dtsi"

/ {
	compatible = "realtek,rtd1319";
};
