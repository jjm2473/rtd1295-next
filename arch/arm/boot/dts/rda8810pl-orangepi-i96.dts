/*
 * Copyright (c) 2017 Andreas Färber
 *
 * SPDX-License-Identifier: (GPL-2.0+ OR MIT)
 */

/dts-v1/;

#include "rda8810pl.dtsi"

/ {
	compatible = "xunlong,orangepi-i96", "rda,8810pl";
	model = "Orange Pi i96";

	chosen {
		stdout-path = "serial3:921600n8";
	};

	memory@80000000 {
		device_type = "memory";
		reg = <0x80000000 0x10000000>;
	};
};

&uart3 {
	status = "okay";
};
